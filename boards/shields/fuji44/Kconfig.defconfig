## boards/shields/fuji44/Kconfig.defconfig
```kconfig
if SHIELD_FUJI44_DONGLE

config ZMK_KEYBOARD_NAME
    default "Fuji44"

config ZMK_SPLIT_ROLE_CENTRAL
    default y

config ZMK_SPLIT_BLE_CENTRAL_PERIPHERALS
    default 2

endif

config ZMK_SPLIT
    default y
```

## config/boards/shields/fuji44/Kconfig.defconfig
```kconfig
if SHIELD_FUJI44_LEFT || SHIELD_FUJI44_RIGHT

config ZMK_KEYBOARD_NAME
    default "Fuji44"

config ZMK_SPLIT
    default y

config ZMK_SPLIT_ROLE_CENTRAL
    default n

endif
```
